#define VERSION_MACRO
macro_ver: macro_ver {
compatible = "zmk,behavior-macro";
label = "macro_ver";
#binding-cells = <0>;
bindings = <&kp N2>, <&kp N0>, <&kp N2>, <&kp N4>, <&kp N1>, <&kp N0>, <&kp N2>, <&kp N6>, <&kp MINUS>, <&kp D>, <&kp E>, <&kp V>, <&kp MINUS>, <&kp N8>, <&kp N2>, <&kp N7>, <&kp N2>, <&kp N4>, <&kp N1>, <&kp N6>, <&kp RET>;
};
